VERSION "PDCAN draft; generated by cargo xtask dbc"

NS_ :

BS_:

BU_: Backpack Host

CM_ "Generated from pdcan_protocol::MESSAGE_DEFINITIONS. IDs use node 1, port 0, and requester 15 as representative values; those fields are dynamic on the bus.";

BO_ 2147515328 PDCAN_EMERGENCY_DISABLE: 8 Host
 SG_ RequestId : 0|64@1+ (1,0) [0|1.8446744073709552e+19] "" Vector__XXX

BO_ 2214609857 PDCAN_SET_PORT_POLICY: 20 Host
 SG_ RequestId : 0|64@1+ (1,0) [0|1.8446744073709552e+19] "" Vector__XXX

BO_ 2214625218 PDCAN_ACKNOWLEDGE_EMERGENCY_RESOLVED: 8 Host
 SG_ RequestId : 0|64@1+ (1,0) [0|1.8446744073709552e+19] "" Vector__XXX

BO_ 2214609859 PDCAN_REQUEST_STATUS: 8 Host
 SG_ RequestId : 0|64@1+ (1,0) [0|1.8446744073709552e+19] "" Vector__XXX

BO_ 2285928384 PDCAN_COMMAND_RESPONSE: 16 Backpack
 SG_ RequestId : 0|64@1+ (1,0) [0|1.8446744073709552e+19] "" Vector__XXX

BO_ 2357215232 PDCAN_PORT_STATE: 16 Backpack

BO_ 2428518400 PDCAN_PORT_POWER: 16 Backpack

BO_ 2499836928 PDCAN_HEARTBEAT: 16 Backpack

BO_ 2499836929 PDCAN_BOARD_INFO: 24 Backpack

BO_ 2608888832 PDCAN_NODE_CLAIM: 16 Backpack
