VERSION "PDCAN Gen-2; generated by cargo xtask dbc"

NS_ :

BS_:

BU_: Node Host

CM_ "Generated from pdcan_protocol::MESSAGE_DEFINITIONS. Operational IDs use node 1, target 15 (or fan 0), and requester 15; commissioning IDs use representative token 1.";

BO_ 2147516352 PDCAN_EMERGENCY_DISABLE: 8 Host
 SG_ RequestId : 0|64@1+ (1,0) [0|1.8446744073709552e+19] "" Vector__XXX

BO_ 2214625217 PDCAN_SET_CARRIER_POLICY: 24 Host
 SG_ RequestId : 0|64@1+ (1,0) [0|1.8446744073709552e+19] "" Vector__XXX

BO_ 2214625218 PDCAN_ACKNOWLEDGE_EMERGENCY: 8 Host
 SG_ RequestId : 0|64@1+ (1,0) [0|1.8446744073709552e+19] "" Vector__XXX

BO_ 2214625219 PDCAN_REQUEST_STATUS: 8 Host
 SG_ RequestId : 0|64@1+ (1,0) [0|1.8446744073709552e+19] "" Vector__XXX

BO_ 2214609860 PDCAN_SET_FAN: 12 Host
 SG_ RequestId : 0|64@1+ (1,0) [0|1.8446744073709552e+19] "" Vector__XXX

BO_ 2214625221 PDCAN_SET_BINDING: 24 Host
 SG_ RequestId : 0|64@1+ (1,0) [0|1.8446744073709552e+19] "" Vector__XXX

BO_ 2285928384 PDCAN_COMMAND_RESPONSE: 16 Node
 SG_ RequestId : 0|64@1+ (1,0) [0|1.8446744073709552e+19] "" Vector__XXX

BO_ 2357230592 PDCAN_NODE_STATE: 16 Node

BO_ 2357215233 PDCAN_FAN_STATE: 12 Node

BO_ 2428533760 PDCAN_POWER: 16 Node

BO_ 2428533761 PDCAN_TEMPERATURE: 16 Node

BO_ 2499836928 PDCAN_HEARTBEAT: 16 Node

BO_ 2499836929 PDCAN_NODE_INFO: 32 Node

BO_ 2499836930 PDCAN_BINDING: 16 Node

BO_ 2508226496 PDCAN_FW_BEGIN: 64 Host
 SG_ RequestId : 0|64@1+ (1,0) [0|1.8446744073709552e+19] "" Vector__XXX

BO_ 2508226497 PDCAN_FW_DATA: 64 Host

BO_ 2508226498 PDCAN_FW_FINISH: 16 Host
 SG_ RequestId : 0|64@1+ (1,0) [0|1.8446744073709552e+19] "" Vector__XXX

BO_ 2508226499 PDCAN_FW_ACTIVATE: 16 Host
 SG_ RequestId : 0|64@1+ (1,0) [0|1.8446744073709552e+19] "" Vector__XXX

BO_ 2508226500 PDCAN_FW_ABORT: 16 Host
 SG_ RequestId : 0|64@1+ (1,0) [0|1.8446744073709552e+19] "" Vector__XXX

BO_ 2508226501 PDCAN_FW_STATUS: 8 Host
 SG_ RequestId : 0|64@1+ (1,0) [0|1.8446744073709552e+19] "" Vector__XXX

BO_ 2508226502 PDCAN_FW_ACK: 24 Node
 SG_ RequestId : 0|64@1+ (1,0) [0|1.8446744073709552e+19] "" Vector__XXX

BO_ 2508226503 PDCAN_FW_STATUS_RESPONSE: 64 Node
 SG_ RequestId : 0|64@1+ (1,0) [0|1.8446744073709552e+19] "" Vector__XXX

BO_ 2608858112 PDCAN_NODE_CLAIM: 16 Node

BO_ 2608859073 PDCAN_DISCOVER: 8 Host

BO_ 2608859074 PDCAN_DISCOVERY_RESPONSE: 64 Node

BO_ 2608859075 PDCAN_IDENTIFY: 24 Host
 SG_ RequestId : 0|64@1+ (1,0) [0|1.8446744073709552e+19] "" Vector__XXX

BO_ 2608859076 PDCAN_ASSIGN_NODE: 24 Host
 SG_ RequestId : 0|64@1+ (1,0) [0|1.8446744073709552e+19] "" Vector__XXX

BO_ 2608859077 PDCAN_CLEAR_NODE: 20 Host
 SG_ RequestId : 0|64@1+ (1,0) [0|1.8446744073709552e+19] "" Vector__XXX

BO_ 2608859078 PDCAN_COMMISSIONING_RESULT: 24 Node
 SG_ RequestId : 0|64@1+ (1,0) [0|1.8446744073709552e+19] "" Vector__XXX
